## drivers/sensor/bosch/Kconfig
```kconfig
# Copyright (c) 2024 Analog Devices, Inc.
# SPDX-License-Identifier: Apache-2.0

# zephyr-keep-sorted-start
rsource "./bma180/Kconfig"
rsource "./bmp085/Kconfig"
rsource "./bmp180/Kconfig"
rsource "./bno055/Kconfig"
# zephyr-keep-sorted-stop
```

## drivers/sensor/bosch/bma180/Kconfig
```kconfig
# BMA180 Three Axis Accelerometer configuration options

# Copyright (c) 2016 Intel Corporation
# SPDX-License-Identifier: Apache-2.0

menuconfig BMA180
	bool "BMA180 Three Axis Accelerometer Family"
	default y
	depends on DT_HAS_BOSCH_BMA180_ENABLED
	select I2C
	help
	  Enable driver for BMA180 I2C-based triaxial accelerometer sensor
	  family.

if BMA180

choice
	prompt "Acceleration measurement range"
	default BMA180_RANGE_2G
	help
	  Measurement range for acceleration values.

config BMA180_RANGE_1G
	bool "+/-1g"

config BMA180_RANGE_1_5G
	bool "+/-1.5g"

config BMA180_RANGE_2G
	bool "+/-2g"

config BMA180_RANGE_3G
	bool "+/-3g"

config BMA180_RANGE_4G
	bool "+/-4g"

config BMA180_RANGE_8G
	bool "+/-8g"

config BMA180_RANGE_16G
	bool "+/-16g"

endchoice

choice
	prompt "Acceleration data filter bandwidth"
	default BMA180_BW_150HZ
	help
	  Bandwidth of filtered acceleration data.

config BMA180_BW_10HZ
	bool "10Hz"

config BMA180_BW_20HZ
	bool "20Hz"

config BMA180_BW_40HZ
	bool "40Hz"

config BMA180_BW_75HZ
	bool "75Hz"

config BMA180_BW_150HZ
	bool "150Hz"

config BMA180_BW_300HZ
	bool "300Hz"

config BMA180_BW_600HZ
	bool "600Hz"

config BMA180_BW_1200HZ
	bool "1200Hz"

config BMA180_BW_HIGHPASS
	bool "High pass 1Hz"

config BMA180_BW_BANDPASS
	bool "Band pass 0.2-300Hz"


endchoice

endif # BMA180
```

## drivers/sensor/bosch/bmp085/Kconfig
```kconfig
menuconfig BMP085
        bool "BMP085 pressure sensor"
        default y
        depends on DT_HAS_BOSCH_BMP085_ENABLED
        select I2C
        help
          Enable driver for BMP085/BMP180 I2C-based pressure sensor.

if BMP085

choice
        prompt "Oversampling"
        default BMP085_OVERSAMPLING_HIGH
        depends on BMP085
        help
          Sampling accuracy.

config BMP085_OVERSAMPLING_LOW
        bool "Low (10 ms)"

config BMP085_OVERSAMPLING_STANDARD
        bool "Standard (13 ms)"

config BMP085_OVERSAMPLING_HIGH
        bool "High (19 ms)"

config BMP085_OVERSAMPLING_ULTRA
        bool "Ultra (31 ms)"

endchoice

endif  # if BMP085
```

## drivers/sensor/bosch/bno055/Kconfig
```kconfig
menuconfig BNO055
        bool "BNO055 9DOF sensor with built-in fusion"
        default y
        depends on DT_HAS_BOSCH_BNO055_ENABLED
        select I2C
        help
          Enable driver for BNO055 I2C-based triaxial accelerometer sensor
          family.

if BNO055

choice
        prompt "Trigger mode"
        default BNO055_TRIGGER_NONE
        help
          Specify the type of triggering to be used by the driver.

config BNO055_TRIGGER_NONE
        bool "No trigger"

config BNO055_TRIGGER_GLOBAL_THREAD
        bool "Use global thread"
        select BNO055_TRIGGER

config BNO055_TRIGGER_OWN_THREAD
        bool "Use own thread"
        select BNO055_TRIGGER
endchoice


config BNO055_TRIGGER
        bool

config BNO055_THREAD_PRIORITY
        int "Own thread priority"
        depends on BNO055_TRIGGER_OWN_THREAD
        default 10
        help
          The priority of the thread used for handling interrupts.

config BNO055_THREAD_STACK_SIZE
        int "Own thread stack size"
        depends on BNO055_TRIGGER_OWN_THREAD
        default 1024
        help
          The thread stack size.

choice
        prompt "Operation mode"
        default BNO055_OPERATION_MODE_ACCEL_GYRO_MAGN
        help
          Specify operation mode and enabled sensors

config BNO055_OPERATION_MODE_ACCEL_ONLY
        bool "Accelerometer only"

config BNO055_OPERATION_MODE_MAGN_ONLY
        bool "Magnetometer only"

config BNO055_OPERATION_MODE_GYRO_ONLY
        bool "Magnetometer only"

config BNO055_OPERATION_MODE_ACCEL_MAGN
        bool "Accelerometer and magnetometer"

config BNO055_OPERATION_MODE_ACCEL_GYRO
        bool "Accelerometer and gyro"

config BNO055_OPERATION_MODE_GYRO_MAGN
        bool "Gyro and magnetometer"

config BNO055_OPERATION_MODE_ACCEL_GYRO_MAGN
        bool "All sensors"

config BNO055_OPERATION_MODE_IMU
        bool "Fusion IMU"

config BNO055_OPERATION_MODE_COMPASS
        bool "Fusion Compass"

config BNO055_OPERATION_MODE_M4G
        bool "Fusion M4G"

config BNO055_OPERATION_MODE_NDOF_FMC_OFF
        bool "Fusion NDOF FMC off"

config BNO055_OPERATION_MODE_NDOF
        bool "Fusion NDOF"

endchoice

choice
        prompt "Accelerometer range setting"
        depends on  BNO055_OPERATION_MODE_ACCEL_ONLY || BNO055_OPERATION_MODE_ACCEL_MAGN || BNO055_OPERATION_MODE_ACCEL_GYRO || BNO055_OPERATION_MODE_ACCEL_GYRO_MAGN
        default BNO055_ACCEL_RANGE_4G


config BNO055_ACCEL_RANGE_2G
        bool "2G"

config BNO055_ACCEL_RANGE_4G
        bool "4G"

config BNO055_ACCEL_RANGE_8G
        bool "8G"

config BNO055_ACCEL_RANGE_16G
        bool "16G"

endchoice

choice
        prompt "Accelerometer bandwidth"
        depends on  BNO055_OPERATION_MODE_ACCEL_ONLY || BNO055_OPERATION_MODE_ACCEL_MAGN || BNO055_OPERATION_MODE_ACCEL_GYRO || BNO055_OPERATION_MODE_ACCEL_GYRO_MAGN
        default BNO055_ACCEL_BANDWIDTH_125HZ


config BNO055_ACCEL_BANDWIDTH_8HZ
        bool "8 Hz"

config BNO055_ACCEL_BANDWIDTH_16HZ
        bool "16 Hz"

config BNO055_ACCEL_BANDWIDTH_32HZ
        bool "32 Hz"

config BNO055_ACCEL_BANDWIDTH_63HZ
        bool "63 Hz"

config BNO055_ACCEL_BANDWIDTH_125HZ
        bool "125 Hz"

config BNO055_ACCEL_BANDWIDTH_250HZ
        bool "250 Hz"

config BNO055_ACCEL_BANDWIDTH_500HZ
        bool "500 Hz"

config BNO055_ACCEL_BANDWIDTH_1000HZ
        bool "1000 Hz"

endchoice

choice
        prompt "Gyro range"
        depends on  BNO055_OPERATION_MODE_GYRO_ONLY || BNO055_OPERATION_MODE_GYRO_MAGN || BNO055_OPERATION_MODE_ACCEL_GYRO || BNO055_OPERATION_MODE_ACCEL_GYRO_MAGN
        default BNO055_GYRO_RANGE_500DPS

config BNO055_GYRO_RANGE_125DPS
        bool "125 dps"

config BNO055_GYRO_RANGE_250DPS
        bool "250 dps"

config BNO055_GYRO_RANGE_500DPS
        bool "500 dps"

config BNO055_GYRO_RANGE_1000DPS
        bool "1000 dps"

config BNO055_GYRO_RANGE_2000DPS
        bool "2000 dps"

endchoice

choice
        prompt "Gyro bandwidth"
        depends on  BNO055_OPERATION_MODE_GYRO_ONLY || BNO055_OPERATION_MODE_GYRO_MAGN || BNO055_OPERATION_MODE_ACCEL_GYRO || BNO055_OPERATION_MODE_ACCEL_GYRO_MAGN
        default BNO055_GYRO_BANDWIDTH_116HZ

config BNO055_GYRO_BANDWIDTH_12HZ
        bool "12 Hz"

config BNO055_GYRO_BANDWIDTH_23HZ
        bool "23 Hz"

config BNO055_GYRO_BANDWIDTH_32HZ
        bool "32 Hz"

config BNO055_GYRO_BANDWIDTH_47HZ
        bool "47 Hz"

config BNO055_GYRO_BANDWIDTH_64HZ
        bool "64 Hz"

config BNO055_GYRO_BANDWIDTH_116HZ
        bool "116 Hz"

config BNO055_GYRO_BANDWIDTH_230HZ
        bool "230 Hz"

config BNO055_GYRO_BANDWIDTH_523HZ
        bool "523 Hz"

endchoice

choice
        prompt "Magnetometer operation mode"
        depends on  BNO055_OPERATION_MODE_MAGN_ONLY || BNO055_OPERATION_MODE_GYRO_MAGN || BNO055_OPERATION_MODE_ACCEL_MAGN || BNO055_OPERATION_MODE_ACCEL_GYRO_MAGN
        default BNO055_MAGN_OPERATION_MODE_REGULAR

config BNO055_MAGN_OPERATION_MODE_LOW_POWER
        bool "Low power"

config BNO055_MAGN_OPERATION_MODE_REGULAR
        bool "Regular"

config BNO055_MAGN_OPERATION_MODE_ENHANCED_REGULAR
        bool "Enhanced regular"

config BNO055_MAGN_OPERATION_MODE_HIGH_ACCURACY
        bool "High accuracy"

endchoice

choice
        prompt "Magnetometer power mode"
        depends on  BNO055_OPERATION_MODE_MAGN_ONLY || BNO055_OPERATION_MODE_GYRO_MAGN || BNO055_OPERATION_MODE_ACCEL_MAGN || BNO055_OPERATION_MODE_ACCEL_GYRO_MAGN
        default BNO055_MAGN_POWER_MODE_NORMAL

config BNO055_MAGN_POWER_MODE_NORMAL
        bool "Normal"

config BNO055_MAGN_POWER_MODE_SLEEP
        bool "Sleep"

config BNO055_MAGN_POWER_MODE_SUSPEND
        bool "Suspend"

config BNO055_MAGN_POWER_MODE_FORCE_MODE
        bool "Force mode"

endchoice

choice
        prompt "Magnetometer data rate"
        depends on  BNO055_OPERATION_MODE_MAGN_ONLY || BNO055_OPERATION_MODE_GYRO_MAGN || BNO055_OPERATION_MODE_ACCEL_MAGN || BNO055_OPERATION_MODE_ACCEL_GYRO_MAGN
        default BNO055_MAGN_DATA_RATE_10HZ

config BNO055_MAGN_DATA_RATE_2HZ
        bool "2 Hz"

config BNO055_MAGN_DATA_RATE_6HZ
        bool "6 Hz"

config BNO055_MAGN_DATA_RATE_8HZ
        bool "8 Hz"

config BNO055_MAGN_DATA_RATE_10HZ
        bool "10 Hz"

config BNO055_MAGN_DATA_RATE_15HZ
        bool "15 Hz"

config BNO055_MAGN_DATA_RATE_20HZ
        bool "20 Hz"

config BNO055_MAGN_DATA_RATE_25HZ
        bool "25 Hz"

config BNO055_MAGN_DATA_RATE_30HZ
        bool "30 Hz"

endchoice

endif  # if BNO055
```

## drivers/sensor/st/Kconfig
```kconfig
rsource "l3gd20h/Kconfig"
rsource "lsm9ds1_ag/Kconfig"
rsource "lsm9ds1_magn/Kconfig"
rsource "h3lis331dl/Kconfig"
```

## drivers/sensor/st/h3lis331dl/Kconfig
```kconfig
# H3LIS331DL Three Axis Accelerometer configuration options

# Copyright (c) 2016 Intel Corporation
# SPDX-License-Identifier: Apache-2.0

menuconfig H3LIS331DL
	bool "H3LIS331DL Three Axis Accelerometer Family"
	default y
	depends on DT_HAS_ST_H3LIS331DL_ENABLED
	select I2C
	help
	  Enable driver for H3LIS331DL I2C-based triaxial accelerometer sensor
	  family.

if H3LIS331DL

choice
	prompt "Acceleration measurement range"
	default H3LIS331DL_RANGE_100G
	help
	  Measurement range for acceleration values.

config H3LIS331DL_RANGE_100G
	bool "+/-100g"

config H3LIS331DL_RANGE_200G
	bool "+/-200g"

config H3LIS331DL_RANGE_400G
	bool "+/-400g"

endchoice

choice
	prompt "Acceleration output data rate"
	default H3LIS331DL_ODR_100HZ
	help
	  Output data rate.

config H3LIS331DL_ODR_50HZ
	bool "50Hz"

config H3LIS331DL_ODR_100HZ
	bool "100Hz"

config H3LIS331DL_ODR_400HZ
	bool "400Hz"

config H3LIS331DL_ODR_1000HZ
	bool "1000Hz"

endchoice

endif # H3LIS331DL
```

## drivers/sensor/st/l3gd20h/Kconfig
```kconfig
# L3GD20H gyro configuration options

# Copyright (c) 2024 J.R. Versteegh
# SPDX-License-Identifier: Apache-2.0

menuconfig L3GD20H
	bool "L3GD20H I2C gyro"
	default y
	depends on DT_HAS_ST_L3GD20H_ENABLED
	select I2C
	help
	  Enable driver for L3GD20H I2C-based gyro sensor.

if L3GD20H


menu "Attributes"

choice
	prompt "Gyro data rate"
	default L3GD20H_ODR_200
	help
	  Specify the default sampling rate frequency for gyro.

config L3GD20H_ODR_12_5
	bool "12.5 Hz"

config L3GD20H_ODR_25
	bool "25 Hz"

config L3GD20H_ODR_50
	bool "50 Hz"

config L3GD20H_ODR_100
	bool "100 Hz"

config L3GD20H_ODR_200
	bool "200 Hz"

config L3GD20H_ODR_400
	bool "400 Hz"

config L3GD20H_ODR_800
	bool "800 Hz"

endchoice


choice
	prompt "Gyro full-scale"
    default L3GD20H_FS_245
    help
      Specify the default full-scale for gyroscope.

    config L3GD20H_FS_245
    bool "245 dps"

    config L3GD20H_FS_500
    bool "500 dps"

    config L3GD20H_FS_2000
	bool "2000 dps"

endchoice

choice
	prompt "Gyro low-pass filter cut-off"
	default L3GD20H_FILTER_CUTOFF_3
    help
      Filter cut-off frequency of low pass filter. Actual value
      depends on sampling frequency and is approx (BW + 1) * sqrt(SFR)

config L3GD20H_FILTER_CUTOFF_0
	bool "~1 * sqrt(SFR)"

config L3GD20H_FILTER_CUTOFF_1
	bool "~2 * sqrt(SFR)"

config L3GD20H_FILTER_CUTOFF_2
	bool "~3 * sqrt(SFR)"

config L3GD20H_FILTER_CUTOFF_3
	bool "~4 * sqrt(SFR)"


endchoice
config L3GD20H_SET_RUNTIME
	bool "Set sensor attributes at runtime"
	help
	  Enable alteration of gyro attributes at
	  runtime.

endmenu

endif # L3GD20H
```
