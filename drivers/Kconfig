## drivers/sensor/st/lsm9ds1/Kconfig
```kconfig
# LSM9DS1 gyroscope sensor configuration options

# Copyright (c) 2016 Intel Corporation
# SPDX-License-Identifier: Apache-2.0

menuconfig LSM9DS1
	bool "LSM9DS1 Accelerometer and Gyroscope"
	default y
	depends on DT_HAS_ST_LSM9DS1_ENABLED
	select I2C
	help
	  Enable driver for LSM9DS1 I2C-based accelerometer and gyroscope sensor.

if LSM9DS1

config LSM9DS1_ACCEL_ENABLE
    bool "Enable accelerometer"
    default y

config LSM9DS1_GYRO_ENABLE
    bool "Enable gyroscope"
    default y

choice
        prompt "Trigger mode"
        default LSM9DS1_TRIGGER_NONE
        help
          Specify the type of triggering to be used by the driver.

config LSM9DS1_TRIGGER_NONE
        bool "No trigger"

config LSM9DS1_TRIGGER_GLOBAL_THREAD
        bool "Use global thread"
        select LSM9DS1_TRIGGER

config LSM9DS1_TRIGGER_OWN_THREAD
        bool "Use own thread"
        select LSM9DS1_TRIGGER
endchoice


config LSM9DS1_TRIGGER
        bool

config LSM9DS1_THREAD_PRIORITY
        int "Own thread priority"
        depends on LSM9DS1_TRIGGER_OWN_THREAD
        default 10
        help
          The priority of the thread used for handling interrupts.

config LSM9DS1_THREAD_STACK_SIZE
        int "Own thread stack size"
        depends on LSM9DS1_TRIGGER_OWN_THREAD
        default 1024
        help
          The thread stack size.

config LSM9DS1_ACCEL_SET_RUNTIME
	bool "Set sensor attributes at runtime"
	depends on DT_HAS_ST_LSM9DS1_ENABLED
	help
	  Enable alteration of sensor attributes at runtime.


menu "Attributes"

choice
	prompt "Accelerometer sampling rate and output rate (ODR)"
	default LSM9DS1_ACCEL_SAMPLING_RATE_476
	depends on LSM9DS1_ACCEL_ENABLE
	help
	  Specify the default sampling rate frequency for accelerometer.

config LSM9DS1_ACCEL_SAMPLING_RATE_10
	bool "10 Hz"

config LSM9DS1_ACCEL_SAMPLING_RATE_50
	bool "50 Hz"

config LSM9DS1_ACCEL_SAMPLING_RATE_119
	bool "119 Hz"

config LSM9DS1_ACCEL_SAMPLING_RATE_238
	bool "238 Hz"

config LSM9DS1_ACCEL_SAMPLING_RATE_476
	bool "476 Hz"

config LSM9DS1_ACCEL_SAMPLING_RATE_952
	bool "952 Hz"


endchoice

choice
	prompt "Accelerometer full-scale"
	default LSM9DS1_ACCEL_FULL_SCALE_2
	depends on LSM9DS1_ACCEL_ENABLE
	help
	  Specify the default full-scale for the accelerometer.

config LSM9DS1_ACCEL_FULL_SCALE_2
	bool "2G"

config LSM9DS1_ACCEL_FULL_SCALE_4
	bool "4G"

config LSM9DS1_ACCEL_FULL_SCALE_8
	bool "8G"

config LSM9DS1_ACCEL_FULL_SCALE_16
	bool "16G"

endchoice


config LSM9DS1_ACCEL_ENABLE_BW_SETTING
    bool "Enable filter bandwith setting"
    default n

choice 
    prompt "Filter bandwidth frequency"
    depends on LSM9DS1_ACCEL_ENABLE_BW_SETTING
    default LSM9DS1_ACCEL_BW_FILTER_105

config LSM9DS1_ACCEL_BW_FILTER_408
    bool "408 Hz"

config LSM9DS1_ACCEL_BW_FILTER_211
    bool "211 Hz"

config LSM9DS1_ACCEL_BW_FILTER_105
    bool "105 Hz"

config LSM9DS1_ACCEL_BW_FILTER_50
    bool "50 Hz"

endchoice

choice
	prompt "Gyroscope sampling rate and output data rate (ODR)"
	default LSM9DS1_GYRO_SAMPLING_RATE_476
	depends on LSM9DS1_GYRO_ENABLE
	help
	  Specify the default sampling rate frequency for gyroscope.

config LSM9DS1_GYRO_SAMPLING_RATE_14_9
    bool "14.9 Hz"

config LSM9DS1_GYRO_SAMPLING_RATE_59_5
    bool "59.5 Hz"

config LSM9DS1_GYRO_SAMPLING_RATE_119
    bool "119 Hz"

config LSM9DS1_GYRO_SAMPLING_RATE_238
    bool "238 Hz"

config LSM9DS1_GYRO_SAMPLING_RATE_476
    bool "476 Hz"

config LSM9DS1_GYRO_SAMPLING_RATE_952
    bool "952 Hz"

endchoice

choice
	prompt "Gyro full-scale"
	default LSM9DS1_GYRO_FULLSCALE_245
	depends on LSM9DS1_GYRO_ENABLE
	help
	  Specify the default full-scale for the gyroscope.

config LSM9DS1_GYRO_FULLSCALE_245
	bool "245 DPS"

config LSM9DS1_GYRO_FULLSCALE_500
	bool "500 DPS"

config LSM9DS1_GYRO_FULLSCALE_2000
	bool "2000 DPS"

endchoice

config LSM9DS1_GYRO_SECOND_LPF_ENABLE
    bool "Enable second low pass filter"
    depends on LSM9DS1_GYRO_ENABLE
    default n

choice 
    prompt "Gyro second low pass filter setting"
    default LSM9DS1_GYRO_BW_FILTER_MID_HIGH
	depends on LSM9DS1_GYRO_SECOND_LPF_ENABLE

config LSM9DS1_GYRO_BW_FILTER_LOW
    bool "Low filter cut off approx ODR/20"

config LSM9DS1_GYRO_BW_FILTER_MID_LOW
    bool "Mid low cut off approx ODR/12"

config LSM9DS1_GYRO_BW_FILTER_MID_HIGH
    bool "Mid high filter cut off approx ODR/8"

config LSM9DS1_GYRO_BW_FILTER_HIGH
    bool "High filter cut off approx ODR/4"

endchoice

config LSM9DS1_GYRO_HPF_ENABLE
    bool "Enable high pass filter"
    depends on LSM9DS1_GYRO_ENABLE
    default n

choice 
    prompt "Gyro high pass filter setting"
    default LSM9DS1_GYRO_HPF_FILTER_ODR_DIV_5000
	depends on LSM9DS1_GYRO_HPF_ENABLE

config LSM9DS1_GYRO_HPF_FILTER_ODR_DIV_15
    bool "ODR / 15 Hz"

config LSM9DS1_GYRO_HPF_FILTER_ODR_DIV_30
    bool "ODR / 30 Hz"

config LSM9DS1_GYRO_HPF_FILTER_ODR_DIV_60
    bool "ODR / 60 Hz"

config LSM9DS1_GYRO_HPF_FILTER_ODR_DIV_150
    bool "ODR / 150 Hz"

config LSM9DS1_GYRO_HPF_FILTER_ODR_DIV_250
    bool "ODR / 250 Hz"

config LSM9DS1_GYRO_HPF_FILTER_ODR_DIV_500
    bool "ODR / 500 Hz"

config LSM9DS1_GYRO_HPF_FILTER_ODR_DIV_1000
    bool "ODR / 1000 Hz"

config LSM9DS1_GYRO_HPF_FILTER_ODR_DIV_2500
    bool "ODR / 2500 Hz"

config LSM9DS1_GYRO_HPF_FILTER_ODR_DIV_5000
    bool "ODR / 5000 Hz"

config LSM9DS1_GYRO_HPF_FILTER_ODR_DIV_10000
    bool "ODR / 10000 Hz"

endchoice


endmenu


endif # LSM9DS1
```

## drivers/sensor/st/lsm9ds1_magn/Kconfig
```kconfig
# LSM9DS1 accelerometer, magnetometer and temperature configuration options

# Copyright (c) 2016 Intel Corporation
# SPDX-License-Identifier: Apache-2.0

menuconfig LSM9DS1_MAGN
	bool "LSM9DS1 I2C magnetometer"
	default y
	depends on DT_HAS_ST_LSM9DS1_MAGN_ENABLED
	select I2C
	help
	  Enable driver for LSM9DS1 I2C-based MFD sensor.

if LSM9DS1_MAGN


menu "Attributes"

config LSM9DS1_MAGN_TEMP_COMP
    bool "Use temperature compensation"
    default y
    help
      Use temperature compensation

choice
	prompt "Power mode"
	default LSM9DS1_MAGN_HIGH_PERF

config LSM9DS1_MAGN_LOW_POWER
	bool "Low power"

config LSM9DS1_MAGN_MED_PERF
	bool "Medium performance"

config LSM9DS1_MAGN_HIGH_PERF
	bool "High performance"

config LSM9DS1_MAGN_ULTRA_PERF
	bool "Ultra performance"

endchoice

choice
	prompt "Magnetometer sampling rate"
	default LSM9DS1_MAGN_SAMPLING_RATE_10
	help
	  Specify the default sampling rate frequency for magnetometer.

config LSM9DS1_MAGN_SAMPLING_RATE_0_625
	bool "0.625 Hz"

config LSM9DS1_MAGN_SAMPLING_RATE_1_25
	bool "1.25 Hz"

config LSM9DS1_MAGN_SAMPLING_RATE_2_5
	bool "2.5 Hz"

config LSM9DS1_MAGN_SAMPLING_RATE_5
	bool "5 Hz"

config LSM9DS1_MAGN_SAMPLING_RATE_10
	bool "10 Hz"

config LSM9DS1_MAGN_SAMPLING_RATE_20
	bool "20 Hz"

config LSM9DS1_MAGN_SAMPLING_RATE_40
	bool "40 Hz"

config LSM9DS1_MAGN_SAMPLING_RATE_80
	bool "80 Hz"

endchoice

config LSM9DS1_MAGN_SAMPLING_RATE_RUNTIME
	bool "Dynamic sampling rate for magnetometer"
	help
	  Enable alteration of magnetometer sampling rate attribute at
	  runtime.

choice
	prompt "Magnetometer full-scale"
	default LSM9DS1_MAGN_FULL_SCALE_4
	help
	  Specify the default full-scale for magnetometer.


config LSM9DS1_MAGN_FULL_SCALE_4
	bool "4 Gauss"

config LSM9DS1_MAGN_FULL_SCALE_8
	bool "8 Gauss"

config LSM9DS1_MAGN_FULL_SCALE_12
	bool "12 Gauss"

config LSM9DS1_MAGN_FULL_SCALE_16
	bool "16 Gauss"

endchoice

config LSM9DS1_MAGN_SET_RUNTIME
	bool "Set sensor attributes at runtime"
	help
	  Enable alteration of magnetometer full-scale attribute at
	  runtime.

endmenu

endif # LSM9DS1_MAGN
```

## drivers/sensor/tdk/icm20498/Kconfig
```kconfig
config ICM20948
	bool "ICM20948 motion tracking sensor"
	depends on (I2C && HAS_DTS_I2C)
	help
		Enable driver for ICM20948.
```

## drivers/sensor/tdk/itg3205/Kconfig
```kconfig
# Copyright (c) 2024 J.R. Versteegh
# SPDX-License-Identifier: Apache-2.0

menuconfig ITG3205
	bool "ITG3205 Gyroscope"
	default y
	depends on DT_HAS_INVENSENSE_ITG3205_ENABLED
	select I2C
	help
	  Enable driver for ITG3205 I2C-based gyroscope.

if ITG3205

config ITG3205_SAMPLE_RATE_DIVIDER
	int "Sample rate divider"
	default 10
	help
	  Internal sample rate is 1kHz (or 8kHz for 256Hz filter). This value divides that sample rate to get to an output data rate.

choice
	prompt "Filter bandwidth"
	default ITG3205_BW_98HZ
	help
	  Gyroscope filter bandwidth. Internal sampling frequency is 1kHz, except for 256Hz filter bandwith, when sets the sampling frequency to 8kHz.

config ITG3205_BW_5HZ
    bool "5 Hz"

config ITG3205_BW_10HZ
    bool "10 Hz"

config ITG3205_BW_20HZ
    bool "20 Hz"

config ITG3205_BW_42HZ
    bool "42 Hz"

config ITG3205_BW_98HZ
    bool "98 Hz"

config ITG3205_BW_188HZ
    bool "188 Hz"

config ITG3205_BW_256HZ
    bool "256 Hz"

endchoice

endif # ITG3205
```

## dts/bindings/sensor/st,l3gd20h.yaml
```yaml
# Copyright (c) 2020 Nordic Semiconductor ASA
# SPDX-License-Identifier: Apache-2.0

description: |
  ST L3GD20H gyroscope.
  https://www.st.com/en/mems-and-sensors/l3gd20.html

compatible: "st,l3gd20h"

include: [sensor-device.yaml, i2c-device.yaml]
```

## dts/bindings/sensor/st,lsm9ds1-ag.yaml
```yaml
# Copyright (c) 2020 Nordic Semiconductor ASA
# SPDX-License-Identifier: Apache-2.0

description: |
  ST LSM9DS1 IMU.  See more info at:
  https://www.st.com/en/mems-and-sensors/lsm9ds1.html

compatible: "st,lsm9ds1-ag"

include: [sensor-device.yaml, i2c-device.yaml]

properties:
  int1-gpios:
    type: phandle-array
    description: |
      Identifies pin for the INT1 signal on the sensor.
```

## dts/bindings/sensor/st,lsm9ds1-magn.yaml
```yaml
# Copyright (c) 2020 Nordic Semiconductor ASA
# SPDX-License-Identifier: Apache-2.0

description: |
  ST LSM9DS1 magnetometer. Part of the LSM9DS1 chip package, but at
  a different I2C address. See more info at:
  https://www.st.com/en/mems-and-sensors/lsm9ds1.html

compatible: "st,lsm9ds1-magn"

include: [sensor-device.yaml, i2c-device.yaml]
```

## dts/bindings/sensor/tdk,icm20948.yaml
```yaml
description:
  TDK InvenSense ICM20948 9DOF motion sensor

compatible: "tdk,icm20948"

include: [sensor-device.yaml, i2c-device.yaml]
```

## dts/bindings/sensor/tdk,itg3205.yaml
```yaml
description:
  TDK InvenSense ITG3205 gyroscope

compatible: "tdk,itg3205"

include: [sensor-device.yaml, i2c-device.yaml]
```

## tests/fp_perf/boards/bbc_microbit_v2/bbc_microbit_v2_defconfig
```kconfig
CONFIG_MICROBIT_DISPLAY=y
CONFIG_MPU_ALLOW_FLASH_WRITE=y
CONFIG_FPU=y
CONFIG_FPU_SHARING=y
CONFIG_FLASH=y
CONFIG_FLASH_PAGE_LAYOUT=y
CONFIG_NVS=y
```
